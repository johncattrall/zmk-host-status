## Kconfig
```kconfig
config ZMK_HOST_STATUS
    bool "Expose keyboard status (layers, split link, build) to host apps over BLE GATT"
    default y
    depends on ZMK_BLE && (!ZMK_SPLIT || ZMK_SPLIT_ROLE_CENTRAL)
    help
      Adds a small GATT service that host apps (e.g. a menu bar indicator)
      can read and subscribe to. Notifies only when status changes.

config ZMK_HOST_STATUS_MODIFIERS
    bool "Report held modifiers"
    default y
    depends on ZMK_HOST_STATUS
    help
      Include the held modifier state in the status payload. Each change of
      a held modifier (including home row mods resolving to a hold) sends a
      short notification. Disable to save the extra Bluetooth traffic.
```
